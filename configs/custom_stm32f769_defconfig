## configs/custom_stm32f769_defconfig
```kconfig
BR2_arm=y
BR2_cortex_m7=y
BR2_DL_DIR="$(TOPDIR)/../dl"
BR2_HOST_DIR="$(TOPDIR)/../host"
BR2_PACKAGE_OVERRIDE_FILE="$(BR2_EXTERNAL_STM32F769_PATH)/configs/local.mk"
BR2_GLOBAL_PATCH_DIR="$(BR2_EXTERNAL_STM32F769_PATH)/stm32f769i-disco/patches"
BR2_TOOLCHAIN_EXTERNAL=y
BR2_TOOLCHAIN_EXTERNAL_DOWNLOAD=y
BR2_TOOLCHAIN_EXTERNAL_URL="file://$(BR2_EXTERNAL_STM32F769_PATH)/toolchain/arm-buildroot-uclinux-uclibcgnueabi_sdk-buildroot.tar.gz"
BR2_TOOLCHAIN_EXTERNAL_GCC_8=y
BR2_TOOLCHAIN_EXTERNAL_HEADERS_5_6=y
# BR2_TOOLCHAIN_EXTERNAL_HAS_THREADS_DEBUG is not set
# BR2_TOOLCHAIN_EXTERNAL_HAS_THREADS_NPTL is not set
BR2_SYSTEM_DHCP="eth0"
BR2_ROOTFS_OVERLAY="$(BR2_EXTERNAL_STM32F769_PATH)/stm32f769i-disco/overlay"
BR2_LINUX_KERNEL=y
BR2_LINUX_KERNEL_USE_CUSTOM_CONFIG=y
BR2_LINUX_KERNEL_CUSTOM_CONFIG_FILE="$(BR2_EXTERNAL_STM32F769_PATH)/stm32f769i-disco/kernel.config"
BR2_LINUX_KERNEL_DTS_SUPPORT=y
BR2_LINUX_KERNEL_DTB_IS_SELF_BUILT=y
BR2_LINUX_KERNEL_INTREE_DTS_NAME="stm32f769-disco"
BR2_PACKAGE_BUSYBOX_CONFIG="$(BR2_EXTERNAL_STM32F769_PATH)/stm32f769i-disco/busybox.config"
BR2_PACKAGE_BUSYBOX_SHOW_OTHERS=y
BR2_PACKAGE_FB_TEST_APP=y
BR2_PACKAGE_SDL=y
BR2_PACKAGE_SDL_TTF=y
BR2_PACKAGE_EVTEST=y
BR2_TARGET_ROOTFS_EXT2=y
# BR2_TARGET_ROOTFS_TAR is not set
BR2_TARGET_UBOOT=y
BR2_TARGET_UBOOT_USE_CUSTOM_CONFIG=y
BR2_TARGET_UBOOT_CUSTOM_CONFIG_FILE="$(BR2_EXTERNAL_STM32F769_PATH)/stm32f769i-disco/uboot.config"
BR2_TARGET_UBOOT_SPL=y
BR2_PACKAGE_HOST_OPENOCD=y
BR2_PACKAGE_HELLO=y
```
